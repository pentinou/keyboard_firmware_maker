## templates/zmk/Kconfig.defconfig.j2
```kconfig
{% if split %}
if SHIELD_{{ shield_name_upper }}_LEFT

config ZMK_KEYBOARD_NAME
	default "{{ display_name }}"

config ZMK_SPLIT_ROLE_CENTRAL
	default y

endif

if SHIELD_{{ shield_name_upper }}_LEFT || SHIELD_{{ shield_name_upper }}_RIGHT

config ZMK_SPLIT
	default y

{% if has_display %}
if ZMK_DISPLAY

config I2C
	default y

config SSD1306
	default y

endif # ZMK_DISPLAY

if LVGL

config LV_Z_VDB_SIZE
	default 64

config LV_DPI_DEF
	default 148

config LV_Z_BITS_PER_PIXEL
	default 1

choice LV_COLOR_DEPTH
	default LV_COLOR_DEPTH_1
endchoice

endif # LVGL
{% endif %}

endif
{% else %}
if SHIELD_{{ shield_name_upper }}

config ZMK_KEYBOARD_NAME
	default "{{ display_name }}"

{% if has_display %}
if ZMK_DISPLAY

config I2C
	default y

config SSD1306
	default y

endif # ZMK_DISPLAY

if LVGL

config LV_Z_VDB_SIZE
	default 64

config LV_DPI_DEF
	default 148

config LV_Z_BITS_PER_PIXEL
	default 1

choice LV_COLOR_DEPTH
	default LV_COLOR_DEPTH_1
endchoice

endif # LVGL
{% endif %}

endif
{% endif %}
```

## templates/zmk/Kconfig.shield.j2
```kconfig
{% if split %}
config SHIELD_{{ shield_name_upper }}_LEFT
	def_bool $(shields_list_contains,{{ shield_name }}_left)

config SHIELD_{{ shield_name_upper }}_RIGHT
	def_bool $(shields_list_contains,{{ shield_name }}_right)
{% else %}
config SHIELD_{{ shield_name_upper }}
	def_bool $(shields_list_contains,{{ shield_name }})
{% endif %}
```
